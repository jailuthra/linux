// SPDX-License-Identifier: GPL-2.0
/*
 * Device Tree Source for AM624 SoC Family Main Domain peripherals
 *
 * Copyright (C) 2021 Texas Instruments Incorporated - https://www.ti.com/
 */

&cbass_wakeup {
	wkup_uart0: serial@2b300000 {
		compatible = "ti,am64-uart", "ti,am654-uart";
		reg = <0x00 0x2b300000 0x00 0x100>;
		reg-shift = <2>;
		reg-io-width = <4>;
		interrupts = <GIC_SPI 186 IRQ_TYPE_LEVEL_HIGH>;
		clock-frequency = <48000000>;
		current-speed = <115200>;
	};
};
