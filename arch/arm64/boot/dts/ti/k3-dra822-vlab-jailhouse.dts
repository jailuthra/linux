// SPDX-License-Identifier: GPL-2.0
/*
 * Device Tree Source for DRA822 ASTC VLAB Model with Jailhouse support
 *
 * Copyright (C) 2016-2018 Texas Instruments Incorporated - http://www.ti.com/
 */

#include "k3-dra822-vlab.dts"

/ {
	model = "Texas Instruments DRA822 ASTC Vlab Model With Jailhouse support";
};

&reserved_memory {
	/*
	 * Reserve for Jailhouse hypervisor firmware and inmates.
	 * Must be in sync with jailhouse cell configurations.
	 */
	hyp_mem: jailhouse@cfb00000 {
		reg = <0x0 0xcfb00000 0x0 0x20500000>;
		alignment = <0x1000>;
		no-map;
	};
};
