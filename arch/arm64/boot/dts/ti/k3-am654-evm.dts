// SPDX-License-Identifier: GPL-2.0
/*
 * Device Tree Source for AM654 ASTC VLAB Model
 *
 * Copyright (C) 2016-2018 Texas Instruments Incorporated - http://www.ti.com/
 */

/dts-v1/;

#include "k3-am6.dtsi"

/ {
	compatible =  "ti,am654-evm", "ti,am654";
	model = "Texas Instruments AM654 GPEVM";

	chosen {
		stdout-path = "serial2:115200n8";
		bootargs = "earlycon=ns16550a,mmio32,0x02800000";
	};

	memory@80000000 {
		device_type = "memory";
		/* PCIE mapped memory - 128MB */
		reg = <0x00000000 0x18000000 0x00000000 0x08000000>;
	};

};

&uart2 {
	status = "okay";
};
