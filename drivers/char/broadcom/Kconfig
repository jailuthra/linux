## drivers/char/broadcom/Kconfig
```kconfig
#
# Broadcom char driver config
#

menuconfig BRCM_CHAR_DRIVERS
	bool "Broadcom Char Drivers"
	help
	  Broadcom's char drivers

if BRCM_CHAR_DRIVERS

config BCM2708_VCMEM
	bool "Videocore Memory"
        default y
        help
          Helper for videocore memory access and total size allocation.

config BCM_VCIO
	tristate "Mailbox userspace access"
	depends on BCM2835_MBOX
	help
	  Gives access to the mailbox property channel from userspace.

endif
```
