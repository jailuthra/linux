## Documentation/devicetree/bindings/dma/ti/kslc-bcdma.yaml
```yaml
# SPDX-License-Identifier: (GPL-2.0-only OR BSD-2-Clause)
%YAML 1.2
---
$id: http://devicetree.org/schemas/dma/ti/kslc-bcdma.yaml#
$schema: http://devicetree.org/meta-schemas/core.yaml#

title: Texas Instruments KSLC DMSS BCDMA Device Tree Bindings

maintainers:
  - Peter Ujfalusi <peter.ujfalusi@ti.com>

description: |
  The Block Copy DMA (BCDMA) is intended to perform similar functions as the TR
  mode channels of K3 UDMA-P.
  BCDMA includes block copy channels and Split channels.
  Bloc copy channels can be used to memory to memory transfers while the split
  channels can be used to serivce PSI-L based peripherals.

  The peripherals serviced by BCDMA can be PSI-L native or legacy, non PSI-L
  native peripherals. In the later case a special, small PDMA is tasked to act
  as a bridge between the PSI-L fabric and the legacy peripheral.

  PDMAs can be configured via BCDMA split channel's peer registers to match with
  the configuration of the legacy peripheral.

allOf:
  - $ref: "../dma-controller.yaml#"

properties:
  "#dma-cells":
    const: 2
    description: |
      The first cell is the PSI-L  thread ID of the remote (to BCDMA) end.
      Valid ranges for thread ID depends on the data movement direction:
      for source thread IDs (rx): 0 - 0x7fff
      for destination thread IDs (tx): 0x8000 - 0xffff

      Please refer to the device documentation for the PSI-L thread map and also
      the PSI-L peripheral chapter for the correct thread ID.

      The second cell is the ASEL value for the channel

  compatible:
    enum:
      - ti,am64-dmss-bcdma

  reg:
    maxItems: 3

  reg-names:
   items:
     - const: gcfg
     - const: bchanrt
     - const: rchanrt
     - const: tchanrt

  msi-parent: true

  ti,sci:
    description: phandle to TI-SCI compatible System controller node
    allOf:
      - $ref: /schemas/types.yaml#/definitions/phandle

  ti,sci-dev-id:
    description: TI-SCI device id of BCDMA
    allOf:
      - $ref: /schemas/types.yaml#/definitions/uint32

  ti,ringacc:
    description: phandle to the ring node
    allOf:
      - $ref: /schemas/types.yaml#/definitions/phandle

  ti,sci-rm-range-bchan:
    description: |
      Array of BCDMA block-copy channel resource subtypes for resource
      allocation for this host
    allOf:
      - $ref: /schemas/types.yaml#/definitions/uint32-array
    minItems: 1
    # Should be enough
    maxItems: 255

  ti,sci-rm-range-tchan:
    description: |
      Array of BCDMA split tx channel resource subtypes for resource allocation
      for this host
    allOf:
      - $ref: /schemas/types.yaml#/definitions/uint32-array
    minItems: 1
    # Should be enough
    maxItems: 255

  ti,sci-rm-range-rchan:
    description: |
      Array of BCDMA split rx channel resource subtypes for resource allocation
      for this host
    allOf:
      - $ref: /schemas/types.yaml#/definitions/uint32-array
    minItems: 1
    # Should be enough
    maxItems: 255

required:
  - compatible
  - "#dma-cells"
  - reg
  - reg-names
  - msi-parent
  - ti,sci
  - ti,sci-dev-id
  - ti,ringacc
  - ti,sci-rm-range-bchan
  - ti,sci-rm-range-tchan
  - ti,sci-rm-range-rchan

additionalProperties: false

examples:
  - |+
    cbass_main {
        #address-cells = <2>;
        #size-cells = <2>;

        main_dmss {
            compatible = "simple-mfd";
            #address-cells = <2>;
            #size-cells = <2>;
            dma-ranges;
            ranges;

            ti,sci-dev-id = <25>;

            main_bcdma: dma-controller@485c0100 {
                compatible = "ti,am64-dmss-bcdma";
                #address-cells = <2>;
                #size-cells = <2>;
                ranges;

                reg = <0x0 0x485c0100 0x0 0x100>,
                      <0x0 0x4c000000 0x0 0x20000>,
                      <0x0 0x4a820000 0x0 0x20000>,
                      <0x0 0x4aa40000 0x0 0x20000>;
                reg-names = "gcfg", "bchanrt", "rchanrt", "tchanrt";
                msi-parent = <&inta_main_dmss>;
                #dma-cells = <2>;

                ti,sci = <&dmsc>;
                ti,sci-dev-id = <26>;
                ti,ringacc = <&bcdma_ring>;

                ti,sci-rm-range-bchan = <0x20>; /* BLOCK_COPY_CHAN */
                ti,sci-rm-range-rchan = <0x21>; /* SPLIT_TR_RX_CHAN */
                ti,sci-rm-range-tchan = <0x22>; /* SPLIT_TR_TX_CHAN */

                bcdma_ring: dmss_ring@4ba00000 {
                    compatible = "ti,am64-dmss-rings";
                    reg = <0x0 0x4bc00000 0x0 0x100000>;
                    reg-names = "rt";
                    ti,num-rings = <68>;
                };
            };
        };
    };
```

## Documentation/devicetree/bindings/dma/ti/kslc-pktdma.yaml
```yaml
# SPDX-License-Identifier: (GPL-2.0-only OR BSD-2-Clause)
%YAML 1.2
---
$id: http://devicetree.org/schemas/dma/ti/kslc-pktdma.yaml#
$schema: http://devicetree.org/meta-schemas/core.yaml#

title: Texas Instruments KSLC DMSS PKTDMA Device Tree Bindings

maintainers:
  - Peter Ujfalusi <peter.ujfalusi@ti.com>

description: |
  The Packet DMA (PKTDMA) is intended to perform similar functions as the packet
  mode channels of K3 UDMA-P.
  PKTDMA only includes Split channels to service PSI-L based peripherals.

  The peripherals serviced by PKTDMA can be PSI-L native or legacy, non PSI-L
  native peripherals. In the later case a special, small PDMA is tasked to act
  as a bridge between the PSI-L fabric and the legacy peripheral.

  PDMAs can be configured via PKTDMA split channel's peer registers to match with
  the configuration of the legacy peripheral.

allOf:
  - $ref: "../dma-controller.yaml#"

properties:
  "#dma-cells":
    const: 2
    description: |
      The first cell is the PSI-L  thread ID of the remote (to PKTDMA) end.
      Valid ranges for thread ID depends on the data movement direction:
      for source thread IDs (rx): 0 - 0x7fff
      for destination thread IDs (tx): 0x8000 - 0xffff

      Please refer to the device documentation for the PSI-L thread map and also
      the PSI-L peripheral chapter for the correct thread ID.

      The second cell is the ASEL value for the channel

  compatible:
    enum:
      - ti,am64-dmss-pktdma

  reg:
    maxItems: 3

  reg-names:
   items:
     - const: gcfg
     - const: bchanrt
     - const: rchanrt
     - const: tchanrt

  msi-parent: true

  ti,sci:
    description: phandle to TI-SCI compatible System controller node
    allOf:
      - $ref: /schemas/types.yaml#/definitions/phandle

  ti,sci-dev-id:
    description: TI-SCI device id of PKTDMA
    allOf:
      - $ref: /schemas/types.yaml#/definitions/uint32

  ti,ringacc:
    description: phandle to the ring node
    allOf:
      - $ref: /schemas/types.yaml#/definitions/phandle

  ti,sci-rm-range-tchan:
    description: |
      Array of PKTDMA split tx channel resource subtypes for resource allocation
      for this host
    allOf:
      - $ref: /schemas/types.yaml#/definitions/uint32-array
    minItems: 1
    # Should be enough
    maxItems: 255

  ti,sci-rm-range-tflow:
    description: |
      Array of PKTDMA split tx flow resource subtypes for resource allocation
      for this host
    allOf:
      - $ref: /schemas/types.yaml#/definitions/uint32-array
    minItems: 1
    # Should be enough
    maxItems: 255

  ti,sci-rm-range-rchan:
    description: |
      Array of PKTDMA split rx channel resource subtypes for resource allocation
      for this host
    allOf:
      - $ref: /schemas/types.yaml#/definitions/uint32-array
    minItems: 1
    # Should be enough
    maxItems: 255

  ti,sci-rm-range-rflow:
    description: |
      Array of PKTDMA split rx flow resource subtypes for resource allocation
      for this host
    allOf:
      - $ref: /schemas/types.yaml#/definitions/uint32-array
    minItems: 1
    # Should be enough
    maxItems: 255

required:
  - compatible
  - "#dma-cells"
  - reg
  - reg-names
  - msi-parent
  - ti,sci
  - ti,sci-dev-id
  - ti,ringacc
  - ti,sci-rm-range-tchan
  - ti,sci-rm-range-tflow
  - ti,sci-rm-range-rchan
  - ti,sci-rm-range-rflow

additionalProperties: false

examples:
  - |+
    cbass_main {
        #address-cells = <2>;
        #size-cells = <2>;

        main_dmss {
            compatible = "simple-mfd";
            #address-cells = <2>;
            #size-cells = <2>;
            dma-ranges;
            ranges;

            ti,sci-dev-id = <25>;

            main_pktdma: dma-controller@485c0000 {
                compatible = "ti,am64-dmss-pktdma";
                #address-cells = <2>;
                #size-cells = <2>;
                ranges;

                reg = <0x0 0x485c0000 0x0 0x100>,
                      <0x0 0x4a800000 0x0 0x20000>,
                      <0x0 0x4aa00000 0x0 0x40000>;
                reg-names = "gcfg", "rchanrt", "tchanrt";
                msi-parent = <&inta_main_dmss>;
                #dma-cells = <2>;

                ti,sci = <&dmsc>;
                ti,sci-dev-id = <30>;
                ti,ringacc = <&pktdma_ring>;

                ti,sci-rm-range-tchan = <0x23>, /* UNMAPPED_TX_CHAN */
                                        <0x24>, /* CPSW_TX_CHAN */
                                        <0x25>, /* SAUL_TX_0_CHAN */
                                        <0x26>, /* SAUL_TX_1_CHAN */
                                        <0x27>, /* ICSSG_0_TX_CHAN */
                                        <0x28>; /* ICSSG_1_TX_CHAN */
                ti,sci-rm-range-tflow = <0x10>, /* RING_UNMAPPED_TX_CHAN */
                                        <0x11>, /* RING_CPSW_TX_CHAN */
                                        <0x12>, /* RING_SAUL_TX_0_CHAN */
                                        <0x13>, /* RING_SAUL_TX_1_CHAN */
                                        <0x14>, /* RING_ICSSG_0_TX_CHAN */
                                        <0x15>; /* RING_ICSSG_1_TX_CHAN */
                ti,sci-rm-range-rchan = <0x29>, /* UNMAPPED_RX_CHAN */
                                        <0x2b>, /* CPSW_RX_CHAN */
                                        <0x2d>, /* SAUL_RX_0_CHAN */
                                        <0x2f>, /* SAUL_RX_1_CHAN */
                                        <0x31>, /* SAUL_RX_2_CHAN */
                                        <0x33>, /* SAUL_RX_3_CHAN */
                                        <0x35>, /* ICSSG_0_RX_CHAN */
                                        <0x37>; /* ICSSG_1_RX_CHAN */
                ti,sci-rm-range-rflow = <0x2a>, /* FLOW_UNMAPPED_RX_CHAN */
                                        <0x2c>, /* FLOW_CPSW_RX_CHAN */
                                        <0x2e>, /* FLOW_SAUL_RX_0/1_CHAN */
                                        <0x32>, /* FLOW_SAUL_RX_2/3_CHAN */
                                        <0x36>, /* FLOW_ICSSG_0_RX_CHAN */
                                        <0x38>; /* FLOW_ICSSG_1_RX_CHAN */

                pktdma_ring: dmss_ring@4b800000 {
                    compatible = "ti,am64-dmss-rings";
                    reg = <0x0 0x4b800000 0x0 0x400000>;
                    reg-names = "rt";
                    ti,num-rings = <288>;
                };
            };
        };
    };
```

## Documentation/devicetree/bindings/gpu/ti-pvr.txt
```
Texas Instruments PowerVR 3D Graphics Processing Unit

PowerVR is the family name for series of 3D Graphics Processing Units from Imagination Technologies.
Texas Instruments SoCs have integrated different generations of PowerVR 3D GPUs. For example,
PowerVR GE8430 (Series 8XE) GPU is integrated in TI J721E SoC.

This binding describes PowerVR 3D GPU Series integrated in Texas Instrument SoCs.

Required properties:
 - compatible : value should take the following format:
	"ti,<soc>-pvr", "img,pvr-<gpuversion>"

   accepted values:
	(a) "ti,j721e-pvr", "img,pvr-ge8430" for TI J721E SoC with PowerVR GE8430 GPU

 - reg: base address and length of the GPU registers
 - reg-names : names of registers listed in reg property in same order
 - interrupts : GPU interrupt number
 - power-domains: from SoC device description
 - clocks : from SoC clock binding
 - clock-names : names of clocks listed in clocks property in the same order

Examples:

PowerVR Series8XE GE8430 GPU integrated in TI J721E SoC
	gpu: gpu@4e20000000  {
		compatible = "ti,j721e-pvr", "img,pvr-ge8430";
		reg = <0x4e 0x20000000 0x00 0x80000>;
		reg-names = "gpu_regs";
		interrupts = <GIC_SPI 24 IRQ_TYPE_LEVEL_HIGH>;
		power-domains = <&k3_pds 124>;
		clocks = <&k3clks 123 0>;
		clock-names = "ctrl";
	};
```
