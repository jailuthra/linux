## Documentation/devicetree/bindings/remoteproc/ti,k3-dsp-rproc.txt
```
TI K3 DSP devices
=================

The TI K3 family of SoCs usually have one or more TI DSP Core sub-systems that
are used to offload some of the processor-intensive tasks or algorithms, for
achieving various system level goals.

These processor sub-systems usually contain additional sub-modules like L1
and/or L2 caches/SRAMs, an Interrupt Controller, an external memory controller,
a dedicated local power/sleep controller etc. The DSP processor cores in the
K3 SoCs is usually either a TMS320C66x CorePac processor or a TMS320C7x CorePac
processor.

DSP Device Node:
================
Each DSP Core sub-system is represented as a single DT node. Each node has a
number of required or optional properties that enable the OS running on the
host processor (ARM CorePac) to perform the device management of the remote
processor and to communicate with the remote processor.

Required properties:
--------------------
The following are the mandatory properties:

- compatible:		Should be one of the following,
			    "ti,dra822-c66-dsp" for C66x DSPs on K3 DRA82x SoCs
			    "ti,dra822-c711-dsp" for C7x DSPs on K3 DRA82x SoCs

- reg:			Should contain an entry for each value in 'reg-names'.
			Each entry should have the memory region's start address
			and the size of the region, the representation matching
			the parent node's '#address-cells' and '#size-cells' values.

- reg-names:		Should contain strings with the following names, each
			representing a specific internal memory region (if
			present), and should be defined in this order,
			     "l2sram", "l1pram", "l1dram"
			NOTE: C7x DSPs do not have a "l1pram" memory.

- ti,sci:		Should be a phandle to the TI-SCI System Controller node

- ti,sci-dev-id:	Should contain the TI-SCI device id corresponding to the
			DSP Core. Please refer to the corresponding System
			Controller documentation for valid values for the DSP
			cores.

- ti,sci-proc-ids:	Should contain 2 integer values. The first cell should
			contain the TI-SCI processor id for the DSP core device
			and the second cell should contain the TI-SCI host id to
			which the processor control ownership should be
			transferred to.

- resets:		Should contain the phandle to the reset controller node
			managing the resets for this device, and a reset
			specifier. Please refer to the following reset bindings
			for the reset argument specifier,
			Documentation/devicetree/bindings/reset/ti,sci-reset.txt

- power-domains:	Should contain a phandle to a PM domain provider node
			and an args specifier containing the DSP device id
			value. This property is as per the binding,
			Documentation/devicetree/bindings/soc/ti/sci-pm-domain.txt

- mboxes:		OMAP Mailbox specifier denoting the sub-mailbox, to be
			used for communication with the remote processor. The
			specifier format is as per the bindings,
			Documentation/devicetree/bindings/mailbox/omap-mailbox.txt
			This property should match with the sub-mailbox node
			used in the firmware image.

- memory-region:	phandle to the reserved memory nodes to be associated
			with the remoteproc device. There should be atleast two
			reserved memory nodes defined - the first one would be
			used for dynamic DMA allocations like vrings and vring
			buffers, and the remaining ones used for the firmware
			image sections. The reserved memory nodes should be
			carveout nodes, and should be defined as per the
			bindings in
			Documentation/devicetree/bindings/reserved-memory/reserved-memory.txt

Optional properties:
--------------------

- sram:			pHandle to a reserved on-chip SRAM region. The region
			should be defined as a child node of the respective
			SRAM node, and should be defined as per the generic
			bindings in,
			Documentation/devicetree/bindings/misc/sram.txt


Example:
---------

1. DRA82x SoC
	/* DRA82x remoteproc alias */
	aliases {
		rproc0 = &mcu0_r5f0;
		rproc1 = &mcu0_r5f1;
		rproc2 = &mcu1_r5f0;
		rproc3 = &mcu1_r5f1;
		rproc4 = &mcu2_r5f0;
		rproc5 = &mcu2_r5f1;
		rproc6 = &c66_0;
		rproc7 = &c66_1;
		rproc8 = &c711;
	};

	/* DSP Carveout reserved memory nodes */
	reserved-memory {
		#address-cells = <2>;
		#size-cells = <2>;
		ranges;

		c66_0_dma_memory_region: c66-dma-memory@a6000000 {
			compatible = "shared-dma-pool";
			reg = <0x00 0xa6000000 0x00 0x100000>;
			no-map;
		};

		c66_0_memory_region: c66-memory@a6100000 {
			compatible = "shared-dma-pool";
			reg = <0x00 0xa6100000 0x00 0xf00000>;
			no-map;
		};

		c71_dma_memory_region: c71-dma-memory@a8000000 {
			compatible = "shared-dma-pool";
			reg = <0x00 0xa8000000 0x00 0x100000>;
			no-map;
		};

		c71_memory_region: c71-memory@a8100000 {
			compatible = "shared-dma-pool";
			reg = <0x00 0xa8100000 0x00 0xf00000>;
			no-map;
		};
	};

	cbass_main: interconnect@100000 {
		compatible = "simple-bus";
		#address-cells = <2>;
		#size-cells = <2>;
		ranges = <0x00 0x64800000 0x00 0x64800000 0x00 0x00800000>, /* C71 */
			 <0x4d 0x80800000 0x4d 0x80800000 0x00 0x800000>,   /* C66_0 */
			 <0x4d 0x81800000 0x4d 0x81800000 0x00 0x800000>;   /* C66_1 */

		/* DRA82x C66_0 DSP node */
		c66_0: dsp@4d80800000 {
			compatible = "ti,dra822-c66-dsp";
			reg = <0x4d 0x80800000 0x00 0x00048000>,
			      <0x4d 0x80e00000 0x00 0x00008000>,
			      <0x4d 0x80f00000 0x00 0x00008000>;
			reg-names = "l2sram", "l1pram", "l1dram";
			ti,sci = <&dmsc>;
			ti,sci-dev-id = <139>;
			ti,sci-proc-ids = <0x03 0xFF>;
			resets = <&k3_reset 139 1>;
			power-domains = <&k3_pds 139>;
			memory-region = <&c66_0_dma_memory_region>,
					<&c66_0_memory_region>;
			mboxes = <&mailbox0_cluster3 &mbox_c660>;
		};

		/* DRA82x C7x DSP node */
		c711: dsp@64800000 {
			compatible = "ti,dra822-c711-dsp";
			reg = <0x00 0x64800000 0x00 0x00080000>,
			      <0x00 0x64e00000 0x00 0x0000c000>;
			reg-names = "l2sram", "l1dram";
			ti,sci = <&dmsc>;
			ti,sci-dev-id = <14>;
			ti,sci-proc-ids = <0x30 0xFF>;
			resets = <&k3_reset 14 1>;
			power-domains = <&k3_pds 14>;
			memory-region = <&c71_dma_memory_region>,
					<&c71_memory_region>;
			mboxes = <&mailbox0_cluster4 &mbox_c71>;
		};
	};
```

## Documentation/devicetree/bindings/rtc/ti,k3-rtc.yaml
```yaml
# SPDX-License-Identifier: (GPL-2.0-only OR BSD-2-Clause)
%YAML 1.2
---
$id: http://devicetree.org/schemas/rtc/ti,k3-rtc.yaml#
$schema: http://devicetree.org/meta-schemas/core.yaml#

title: Texas Instruments K3 Real Time Clock

maintainers:
  - Nishanth Menon <nm@ti.com>

description: |
  This RTC appears in the AM62x family of SoCs.

properties:
  compatible:
    items:
      - enum:
          - ti,am62-rtc

  reg:
    maxItems: 1

  interrupts:
    maxItems: 1

  clocks:
    items:
      - description: VBUS Interface clock
      - description: 32k Clock source (external or internal).

  clock-names:
    items:
      - const: "vbus"
      - const: "osc32k"

  power-domains:
    maxItems: 1

  assigned-clocks:
    description: |
      override default osc32k parent clock reference to the osc32k clock entry
    maxItems: 1

  assigned-clock-parents:
    description: |
      override default osc32k parent clock phandle of the new parent clock of osc32k
    maxItems: 1

  wakeup-source: true

required:
  - compatible
  - reg
  - interrupts
  - clocks
  - clock-names

additionalProperties: false

examples:
  - |
    #include <dt-bindings/interrupt-controller/arm-gic.h>
    rtc@2b1f0000 {
        compatible = "ti,am62-rtc";
        reg = <0x2b1f0000 0x100>;
        interrupts = <GIC_SPI 100 IRQ_TYPE_LEVEL_HIGH>;
        power-domains = <&bar 0>;
        clocks = <&foo 0>, <&foo 1>;
        clock-names = "vbus", "osc32k";
        wakeup-source;
    };

  - |
    #include <dt-bindings/interrupt-controller/arm-gic.h>
    rtc@2b1f0000 {
        compatible = "ti,am62-rtc";
        reg = <0x2b1f0000 0x100>;
        interrupts = <GIC_SPI 100 IRQ_TYPE_LEVEL_HIGH>;
        power-domains = <&bar 0>;
        clocks = <&foo 0>, <&foo 1>;
        clock-names = "vbus", "osc32k";
        wakeup-source;
        assigned-clocks = <&foo 1>;
        assigned-clock-parents = <&foo 2>;

    };
```

## Documentation/devicetree/bindings/usb/ti,am62-usb.yaml
```yaml
# SPDX-License-Identifier: GPL-2.0-only OR BSD-2-Clause
%YAML 1.2
---
$id: http://devicetree.org/schemas/usb/ti,am62-usb.yaml#
$schema: http://devicetree.org/meta-schemas/core.yaml#

title: Bindings for the TI's AM62 wrapper module for the Synopsys USBSS-DRD controller

maintainers:
  - Aswath Govindraju <a-govindraju@ti.com>

properties:
  compatible:
    const: ti,am62-usb

  reg:
    maxItems: 1

  ranges: true

  power-domains:
    description:
      PM domain provider node and an args specifier containing
      the USB ISO device id value. See,
      Documentation/devicetree/bindings/soc/ti/sci-pm-domain.yaml
    maxItems: 1

  clocks:
    description: Clock phandles to usb2_refclk
    maxItems: 1

  clock-names:
    items:
      - const: ref

  id-gpio:
    description:
      GPIO to be used as ID pin
    maxItems: 1

  interrupts:
    description:
      interrupt line to be used for detecting changes in VBUS

  ti,vbus-divider:
    description:
      Should be present if USB VBUS line is connected to the
      VBUS pin of the SoC via a 1/3 voltage divider.
    type: boolean

  ti,syscon-phy-pll-refclk:
    $ref: /schemas/types.yaml#/definitions/phandle-array
    items:
      - items:
          - description: Phandle to the SYSCON entry
          - description: USB phy control register offset within SYSCON
    description: Specifier for configuring frequency of ref clock input.

  '#address-cells':
    const: 2

  '#size-cells':
    const: 2

required:
  - compatible
  - reg
  - power-domains
  - clocks
  - clock-names
  - interrupts

additionalProperties: false

examples:
  - | 
    #include <dt-bindings/soc/ti,sci_pm_domain.h>
    #include <dt-bindings/interrupt-controller/arm-gic.h>
    #include <dt-bindings/gpio/gpio.h>

    bus {
      #address-cells = <2>;
      #size-cells = <2>;

      dwc3-usb@f910000 {
        compatible = "ti,am62-usb";
        reg = <0x00 0x0f910000 0x00 0x800>;
        interrupts = <GIC_SPI 234 IRQ_TYPE_LEVEL_HIGH>; /* MISC IRQ */
        clocks = <&k3_clks 162 3>;
        clock-names = "ref";
        ti,syscon-phy-pll-refclk = <&wkup_conf 0x4018>;
        #address-cells = <2>;
        #size-cells = <2>;
        power-domains = <&k3_pds 179 TI_SCI_PD_EXCLUSIVE>;
        id-gpio = <&main_gpio1 51 GPIO_ACTIVE_LOW>;
      };
    };
```

## drivers/rpmsg-kdrv/Kconfig
```kconfig
# SPDX-License-Identifier: GPL-2.0

menu "Rpmsg virtual device drivers"

# RPMSG always gets selected by whoever wants it
config RPMSG_KDRV
	tristate "RPMSG virtual device interface"
	select RPMSG

config RPMSG_KDRV_DISPLAY
	tristate "RPMSG virtual display device support"
	select RPMSG_KDRV

endmenu
```
